// Generated by tools/font_gen.py - edit the drawings there, not this file.
#include <Arduino.h>

#include "font.h"

static const uint8_t FONT_DATA[] PROGMEM = {
  0x5f, 0x03, 0x00, 0x03, 0x14, 0x7f, 0x14, 0x7f, 0x14, 0x23, 0x13, 0x08, 0x64, 0x62, 0x36, 0x49,
  0x55, 0x22, 0x50, 0x03, 0x1c, 0x22, 0x41, 0x41, 0x22, 0x1c, 0x14, 0x08, 0x3e, 0x08, 0x14, 0x08,
  0x08, 0x3e, 0x08, 0x08, 0x80, 0x60, 0x08, 0x08, 0x08, 0x40, 0x60, 0x10, 0x08, 0x04, 0x03, 0x3e,
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  0x0c,
};

struct FontGlyph {
  uint16_t codepoint;
  uint16_t offset;
  uint8_t width;
};

static const FontGlyph FONT_INDEX[] PROGMEM = {
  {0x0021,   0, 1}, // !
  {0x0022,   1, 3}, // "
  {0x0023,   4, 5}, // #
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  {0x2764, 412, 5}, // ❤
};

static const uint16_t FONT_COUNT = 92;
const uint8_t Font::SPACE_WIDTH = 3;

// Binary search in the (sorted) glyph index. Returns false if the font has
// no drawing for this character.
bool Font::find(uint16_t codepoint, uint16_t& offset, uint8_t& width) {
  int lo = 0;
  int hi = FONT_COUNT - 1;

  while (lo <= hi) {
    int mid = (lo + hi) / 2;
    uint16_t cp = pgm_read_word(&FONT_INDEX[mid].codepoint);

    if (cp == codepoint) {
      offset = pgm_read_word(&FONT_INDEX[mid].offset);
      width = pgm_read_byte(&FONT_INDEX[mid].width);
      return true;
    }

    if (cp < codepoint) {
      lo = mid + 1;
    } else {
      hi = mid - 1;
    }
  }

  return false;
}

uint8_t Font::column(uint16_t offset) {
  return pgm_read_byte(&FONT_DATA[offset]);
}

// Decodes the next UTF-8 character of text, starting at pos (advances pos).
uint16_t Font::nextCodepoint(const String& text, unsigned int& pos) {
  uint8_t c = text.charAt(pos++);

  if (c < 0x80) {
    return c;
  }

  int extra = 0;
  uint16_t cp = 0;

  if ((c & 0xe0) == 0xc0) {
    cp = c & 0x1f;
    extra = 1;
  } else if ((c & 0xf0) == 0xe0) {
    cp = c & 0x0f;
    extra = 2;
  } else {
    // 4-byte sequences (emoji) and invalid bytes: skip continuation bytes.
    while (pos < text.length() && (((uint8_t) text.charAt(pos)) & 0xc0) == 0x80) {
      pos++;
    }
    return '?';
  }

  for (int i = 0; i < extra && pos < text.length(); i++) {
    cp = (cp << 6) | (((uint8_t) text.charAt(pos++)) & 0x3f);
  }

  return cp;
}
